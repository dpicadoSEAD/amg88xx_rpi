## meta-amg88xx/conf/layer.conf
```bitbake
# We have a conf and classes directory, add to BBPATH
BBPATH .= ":${LAYERDIR}"

# We have recipes-* directories, add to BBFILES
BBFILES += "${LAYERDIR}/recipes-*/*/*.bb \
	${LAYERDIR}/recipes-*/*/*.bbappend"

BBFILE_COLLECTIONS += "amg88xx"
BBFILE_PATTERN_amg88xx = "^${LAYERDIR}/"
BBFILE_PRIORITY_amg88xx = "7"
```
